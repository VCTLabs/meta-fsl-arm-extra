## conf/machine/udooquad.conf
```bitbake
#@TYPE: Machine
#@NAME: UDOO Neo i.MX6 SoloX
#@SOC: i.MX6S
#@DESCRIPTION: Machine configuration for i.MX6 UDOO Neo SoloX
#@MAINTAINER: Christian Ege <ch@ege.io>

include conf/machine/include/imx-base.inc
include conf/machine/include/tune-cortexa9.inc

SOC_FAMILY = "mx6:mx6q"


PREFERRED_PROVIDER_virtual/kernel ?= "linux-udooboard"
PREFERRED_VERSION_linux-udooboard ?= "3.14.28"
PREFERRED_PROVIDER_u-boot ?= "u-boot-udooboard"
KERNEL_IMAGETYPE = "zImage"

KERNEL_DEVICETREE ?= "imx6q-udoo-hdmi.dtb"

MACHINE_USES_VIVANTE_KERNEL_DRIVER_MODULE ?= "0"

UBOOT_MACHINE ?= "udoo_quad_config"
UBOOT_DEFAULT_DEVICETREE ?= "${KERNEL_DEVICETREE}"

MACHINE_FEATURES += " wifi"

SERIAL_CONSOLES ?= "115200;ttymxc1"
```
